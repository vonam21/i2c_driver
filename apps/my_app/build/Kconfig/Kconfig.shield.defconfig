## apps/my_app/build/Kconfig/Kconfig.shield.defconfig
```kconfig
osource "D:/Desktop/source/driver_i2c/apps/my_app/../..//boards/shields/*/Kconfig.defconfig"
```

## boards/arm/blue_pill_driver/blue_pill_driver_defconfig
```kconfig
# SPDX-License-Identifier: Apache-2.0

CONFIG_SOC_SERIES_STM32F1X=y
CONFIG_SOC_STM32F103XE=y

# enable pin controller
CONFIG_PINCTRL=y

# enable GPIO
CONFIG_GPIO=y

# enable RCC clock control
CONFIG_CLOCK_CONTROL=y


CONFIG_USE_SEGGER_RTT=y

CONFIG_CONSOLE=y
CONFIG_RTT_CONSOLE=y
CONFIG_LOG_BACKEND_RTT=y

CONFIG_LOG=y
CONFIG_RING_BUFFER=y


CONFIG_PRINTK=y
CONFIG_CBPRINTF_FP_SUPPORT=y
CONFIG_I2C_LOG_LEVEL_DBG=y
```

## drivers_ds3231/ds3231_driver/Kconfig
```kconfig
menuconfig DS3231 
    bool "This is my driver gpio"
    help 
        this is my driver gpio 

config CHOSEN_DS3231
    bool "chosen_gpio"
    select NAM_CONTEXT
    default y 
    depends on DT_HAS_ZEPHYR_DS3231_VER1_ENABLED
    help 
        Select this to is gpio driver


config DS3231
    bool "chosen i2c"
```

## drivers_ds3231/dts/bindings/funny_driver_name/zephyr,ds3231-ver1.yaml
```yaml
description: |
    An example sensor that reads the GPIO level defined in input-gpios.

compatible: "zephyr,ds3231-ver1"
properties:
    address:
        type: int
        required: true
include: base.yaml
```
